## drivers/osdp/Kconfig
```kconfig
#
# Copyright (c) 2020 Siddharth Chandrasekaran <siddharth@embedjournal.com>
#
# SPDX-License-Identifier: Apache-2.0
#

menuconfig OSDP
	bool "Open Supervised Device Protocol (OSDP) driver"
	select RING_BUFFER
	select SERIAL
	select SERIAL_HAS_DRIVER
	select SERIAL_SUPPORT_INTERRUPT
	select UART_INTERRUPT_DRIVEN
	select ENTROPY_GENERATOR
	select TEST_RANDOM_GENERATOR
	help
	  Add support for Open Supervised Device Protocol (OSDP)

if OSDP

config OSDP_UART_DEV_NAME
	string "Device mame of UART device for OSDP"
	default "UART_2"
	help
	  This option specifies the name of UART device to be used for
	  OSDP

config OSDP_UART_BAUD_RATE
	int "OSDP UART baud rate"
	default 115200
	help
	  OSDP defines that baud rate can be either 9600 or 38400 or
	  115200.

config OSDP_CRYPTO_DRV_NAME
	string "Crypto driver to use with OSDP"
	default "CRYPTO_MTLS"
	help
	  OSDP Secure Channel uses AES-128 to secure communication between
	  CP and PD. Provide an available crypto driver name here.

config OSDP_LOG_LEVEL
	int "OSDP Logging Level"
	default 1
	help
	  Set the logging level for the OSDP driver

config OSDP_NUM_CONNECTED_PD
	int "Number of connected PDs"
	default 1
	help
	  In CP mode, this variable indicates the number of PD connected
	  the this CP. In multi-drop connection, there can be as many as
	  127 PDs. When initialized as PD, this value must be set to 1.

choice
	prompt "OSDP Mode of Operation"
	config OSDP_MODE_CP
		bool "Configure OSDP in CP mode"
		help
		  Configure this device to operate as a Control Pannel
	config OSDP_MODE_PD
		bool "Configure OSDP in PD mode"
		help
		  Configure this device to operate as a Peripheral Device
endchoice

if OSDP_MODE_PD

config OSDP_PD_ID_VENDOR_CODE
	int "PD Vendor code"
	default 100
	help
	  This integer will be made available to CP in PD_ID command

config OSDP_PD_ID_VERSION
	int "PD Product Version"
	default 103
	help
	  This integer will be made available to CP in PD_ID command

config OSDP_PD_ID_MODEL
	int "PD Product Model"
	default 104
	help
	  This integer will be made available to CP in PD_ID command

config OSDP_PD_ID_SERIAL_NUMBER
	int "PD Serial number"
	default 101
	help
	  This integer will be made available to CP in PD_ID command

config OSDP_PD_ID_FIRMWARE_VERSION
	int "PD firmware version"
	default 102
	help
	  This integer will be made available to CP in PD_ID command

endif #OSDP_MODE_PD

endif # OSDP
```
